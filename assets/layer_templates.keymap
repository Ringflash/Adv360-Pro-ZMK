/ {
  keymap {
    trans { 
      display-name = "NAME ME";
      bindings = <
  &trans   &trans   &trans   &trans   &trans   &trans   &trans                                                         &trans   &trans   &trans   &trans   &trans   &trans   &trans
  &trans   &trans   &trans   &trans   &trans   &trans   &trans                                                         &trans   &trans   &trans   &trans   &trans   &trans   &trans
  &trans   &trans   &trans   &trans   &trans   &trans   &trans            &trans   &trans   &trans   &trans            &trans   &trans   &trans   &trans   &trans   &trans   &trans
  &trans   &trans   &trans   &trans   &trans   &trans                              &trans   &trans                              &trans   &trans   &trans   &trans   &trans   &trans
  &trans   &trans   &trans   &trans   &trans                     &trans   &trans   &trans   &trans   &trans   &trans                     &trans   &trans   &trans   &trans   &trans
      >;
    };
    none { 
      display-name = "NAME ME";
      bindings = <
  &none   &none   &none   &none   &none   &none   &none                                                   &none   &none   &none   &none   &none   &none   &none
  &none   &none   &none   &none   &none   &none   &none                                                   &none   &none   &none   &none   &none   &none   &none
  &none   &none   &none   &none   &none   &none   &none           &none   &none   &none   &none           &none   &none   &none   &none   &none   &none   &none
  &none   &none   &none   &none   &none   &none                           &none   &none                           &none   &none   &none   &none   &none   &none
  &none   &none   &none   &none   &none                   &none   &none   &none   &none   &none   &none                   &none   &none   &none   &none   &none
      >;
    };
  };
};
